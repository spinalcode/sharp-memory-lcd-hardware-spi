#include <SPI.h>

#define WIDTH 144
#define HEIGHT 168

int CS_PIN = 8;
int fCount=0;
int where = 0; // current offset of screen buffer

// 'tetris', 144x504px
const unsigned char bitmap [] = {
  0x00, 0x00, 0x00, 0x00, 0x00, 0x00, 0x00, 0x00, 0x00, 0x00, 0x00, 0x00, 0x00, 0x00, 0x00, 0x00, 
  0x00, 0x00, 0x00, 0x00, 0x00, 0x00, 0x00, 0x00, 0x00, 0x00, 0x00, 0x00, 0x00, 0x00, 0x00, 0x00, 
  0x00, 0x00, 0x00, 0x00, 0x00, 0x00, 0x00, 0x00, 0x00, 0x00, 0x00, 0x00, 0x00, 0x00, 0x00, 0x00, 
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  0xff, 0xff, 0xff, 0xff, 0xff, 0xff, 0xff, 0xff, 0xff, 0xff, 0xff, 0xff, 0xff, 0xff, 0xff, 0xff
};

#define _SHARPMEM_BIT_WRITECMD 0x80
#define _SHARPMEM_BIT_VCOM 0x40
#define _SHARPMEM_BIT_CLEAR 0x20

int vCom = 0;
long unsigned int lastMillis = 0;
int fpsCount = 0;
int framecount = 0;

void setup() {
  Serial.begin(9600);
  SPI.begin();
  pinMode(CS_PIN, OUTPUT);
  digitalWrite(CS_PIN, LOW);
  lastMillis = millis();
}

void loop() {

  writeScreen();

  framecount++;
  if(millis() >= lastMillis+1000){
    lastMillis = millis();
    fpsCount = framecount;
    framecount = 0;
    Serial.println(fpsCount);
  }

}

void writeScreen(){
  // hardware SPI can manages about 100fps on this screen
  digitalWrite(CS_PIN, HIGH);
  SPI.beginTransaction( SPISettings(8000000, LSBFIRST, SPI_MODE0) ); // 8mhz as fast as the nrf52840 will go, but that's 100fps, so that's OK.
  if(vCom){
    SPI.transfer(_SHARPMEM_BIT_WRITECMD | _SHARPMEM_BIT_VCOM);
  }else{
    SPI.transfer(_SHARPMEM_BIT_WRITECMD);
  }

  uint8_t fullLine[20]; // full horizontal line first byte is the line number (1-168) then 18 bytes data, last byte is always 0x00
  uint8_t ln=1; // line number to update
/*
  if(vCom){
    for(uint16_t line=1; line<=168; line++){
      fullLine[0] = reverse_byte(ln++);
      for(int x=1; x<19; x++){
        fullLine[x] = 0xFF;
      }
      fullLine[20] = 0x00;
      SPI.transfer(&fullLine, 20);
    }
  }else{
    for(uint16_t line=1; line<=168; line++){
      fullLine[0] = reverse_byte(ln++);
      for(int x=1; x<19; x++){
        fullLine[x] = bitmap[where++];
      }
      fullLine[20] = 0x00;
      SPI.transfer(&fullLine, 20);
    }
  }
*/

  for(uint16_t line=1; line<=168; line++){
    fullLine[0] = reverse_byte(ln++);
    for(int x=1; x<19; x++){
      fullLine[x] = bitmap[where++];
    }
    fullLine[20] = 0x00;
    SPI.transfer(&fullLine, 20);
  }
  
  SPI.transfer(0x00);
  digitalWrite(CS_PIN, LOW);
  fCount++;
  if(fCount==3){
    fCount=0;
    vCom=1-vCom; // flip the vCom bit at least once per second
    where = 0;
  }
}

unsigned char reverse_byte(unsigned char b) {
   b = (b & 0b11110000) >> 4 | (b & 0b00001111) << 4;
   b = (b & 0b11001100) >> 2 | (b & 0b00110011) << 2;
   b = (b & 0b10101010) >> 1 | (b & 0b01010101) << 1;
   return b;
}
